## config/west.yml
```yaml
manifest:
  remotes:
    - name: zmkfirmware
      url-base: https://github.com/zmkfirmware
    - name: badjeff
      url-base: https://github.com/badjeff
    # Additional modules containing boards/shields/custom code can be listed here as well
    # See https://docs.zephyrproject.org/3.2.0/develop/west/manifest.html#projects
  projects:
    - name: zmk
      remote: zmkfirmware
      revision: ab46f48dde8aa70e44a2fc2d2a1b81ae703d4981 # 
      import: app/west.yml
    - name: zephyr
      remote: zmkfirmware
      revision: ec36516990d40355238db3049bc1709191f99b4e # v4.1.0+zmk-fixes
      import:
        name-blocklist:
          - ci-tools
          - hal_altera
          - hal_cypress
          - hal_infineon
          - hal_microchip
          - hal_nxp
          - hal_openisa
          - hal_silabs
          - hal_xtensa
          - hal_st
          - hal_ti
          - loramac-node
          - mcuboot
          - mcumgr
          - net-tools
          - openthread
          - edtt
          - trusted-firmware-m
    - name: nv-gem
      url: https://github.com/MechboardsLTD/zmk-module
      revision: nv_gem
    - name: zmk-analog-input-driver
      remote: badjeff
      revision: 
  self:
    path: config
```
